## conf/layer.conf
```bitbake
# We have a conf and classes directory, append to BBPATH
BBPATH .= ":${LAYERDIR}"

# We have a recipes directory, add to BBFILES
BBFILES += "${LAYERDIR}/recipes*/*/*.bb ${LAYERDIR}/recipes*/*/*.bbappend"

BBFILE_COLLECTIONS += "meta-map-sheriffco"
BBFILE_PATTERN_meta-map-sheriffco := "^${LAYERDIR}/"
BBFILE_PRIORITY_meta-map-sheriffco = "10"

LICENSE_PATH += "${LAYERDIR}/licenses"
```
